#include "whomst.dtsi"

/ {
    kscan0: kscan0 {
        compatible = "zmk,kscan-gpio-direct";
        wakeup-source;

        input-gpios
            = <&pro_micro 2 (GPIO_ACTIVE_LOW | GPIO_PULL_UP)>
            , <&pro_micro 3 (GPIO_ACTIVE_LOW | GPIO_PULL_UP)>
            , <&pro_micro 4 (GPIO_ACTIVE_LOW | GPIO_PULL_UP)>
            ;
    };
};

&physical_layout_whomst {
    kscan = <&kscan0>;
};
// == Input devices ==
// Input devices on this central part
// Enabling input listeners and pointing them to the input devices
&input_listener_unibody0 {
    status = "okay";
    device = <&input_device_unibody0>;
};

